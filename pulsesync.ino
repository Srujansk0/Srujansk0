#define BLYNK_TEMPLATE_ID "TMPL3Tb2oZcEt"
#define BLYNK_TEMPLATE_NAME "default 1"
//////
#include <SPI.h>
#include <Wire.h>
#include <Adafruit_GFX.h>
#include <Adafruit_SSD1306.h>
/////
#include "MAX30100_PulseOximeter.h"
/////
#include <DHT.h>//adfruit DHT lib
////
#include <Blynk.h>
#include <ESP8266WiFi.h>
#include <BlynkSimpleEsp8266.h>
#define BLYNK_PRINT Serial
////
#define SCREEN_WIDTH 128 // OLED display width, in pixels
#define SCREEN_HEIGHT 64 // OLED display height, in pixels
////
uint8_t DHTPIN = 2; // DHT11 sensor pin D4
#define DHTTYPE DHT11 // DHT11 sensor type
DHT dht(DHTPIN, DHTTYPE);
////
#define OLED_RESET     -1 // Reset pin # (or -1 if sharing Arduino reset pin)
#define SCREEN_ADDRESS 0x3C ///< See datasheet for Address; 0x3D for 128x64, 0x3C for 128x32
Adafruit_SSD1306 display(SCREEN_WIDTH, SCREEN_HEIGHT, &Wire, OLED_RESET);
////
#define NUMFLAKES     10 // Number of snowflakes in the animation example
#define ANALOGIN A0 
////
////
char auth[] = "ftaRomvJjZIHVBqpJyG5qzu5NA94ZiLw";             // You should get Auth Token in the Blynk App.
char ssid[] = "JioFiber-hAa8n";                                     // Your WiFi credentials.
char pass[] = "Mother123";
 ////
#define LOGO_HEIGHT   16
#define LOGO_WIDTH    16
#define REPORTING_PERIOD_MS 1000
PulseOximeter pox;
int h;
float temp, hum ;
BlynkTimer timer;
 ////
uint32_t tsLastReport = 0;
 ////

const unsigned char myBitmap_logo [] PROGMEM = {
	0x00, 0x00, 0x00, 0x00, 0x00, 0x00, 0x00, 0x00, 0x00, 0x00, 0x00, 0x00, 0x00, 0x00, 0x00, 0x00, 
	0x00, 0x00, 0x00, 0x00, 0x00, 0x00, 0x00, 0x00, 0x00, 0x00, 0x00, 0x00, 0x00, 0x00, 0x00, 0x00, 
	0x00, 0x00, 0x00, 0x00, 0x00, 0x00, 0x00, 0x00, 0x00, 0x00, 0x00, 0x00, 0x00, 0x00, 0x00, 0x00, 
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	0x00, 0x00, 0x00, 0x00, 0x00, 0x00, 0x00, 0x00, 0x00, 0x00, 0x00, 0x00, 0x00, 0x00, 0x00, 0x00
};
const unsigned char myBitmap_logo1 [] PROGMEM = {
	0x00, 0x00, 0x00, 0x00, 0x01, 0xe0, 0x1a, 0x00, 0x07, 0xb0, 0x36, 0x00, 0x07, 0x78, 0x6f, 0x00, 
	0x06, 0xcc, 0xd9, 0x80, 0x0d, 0xb5, 0xde, 0xc0, 0x1b, 0x3b, 0xb3, 0x60, 0x36, 0x1f, 0x61, 0xb0, 
	0x0e, 0x0e, 0xc0, 0x18, 0x76, 0x05, 0x81, 0xb4, 0x3b, 0x00, 0x03, 0x70, 0x1d, 0x80, 0x07, 0x60, 
	0x0d, 0x80, 0x0e, 0xc0, 0x06, 0xc0, 0x0d, 0x80, 0x03, 0x60, 0x1b, 0x00, 0x01, 0xb0, 0x36, 0x00, 
	0x00, 0xd8, 0x6c, 0x00, 0x00, 0xec, 0xdc, 0x00, 0x00, 0x75, 0xd8, 0x00, 0x00, 0x33, 0xb0, 0x00, 
	0x00, 0x1f, 0x60, 0x00, 0x00, 0x0e, 0xc0, 0x00, 0x00, 0x05, 0x80, 0x00, 0x00, 0x00, 0x00, 0x00, 
	0x00, 0x00, 0x00, 0x00
};

/*void sendSensor()
{
  int h = analogRead(A0); //89. 
  Blynk.virtualWrite(V5, h);
  //Blynk.virtualWrite(V6, A0);
}*/
///
void onBeatDetected()
{
  Serial.println("Beat!");
  display.drawBitmap( 90, 15,myBitmap_logo1 , 28, 28, 1);
  display.setTextSize(1);
  display.setCursor(0,18);
  display.println("* Pulsesync *");
  display.setCursor(0,25);
  display.println("Please register");
  display.display();
}
////
void setup() 
{
  Serial.begin(9600);
  if(!display.begin(SSD1306_SWITCHCAPVCC, SCREEN_ADDRESS))
  {
    Serial.println(F("SSD1306 allocation failed"));
    for(;;); // Don't proceed, loop forever
  }
  display.display();
  delay(2000); // Pause for 2 seconds
  display.clearDisplay();
  display.setTextSize(2);
  display.setTextColor(1);
  //display.setCursor(15, 0);
  Blynk.begin(auth, ssid, pass);
  //timer.setInterval(1L, sendSensor);
  display.drawBitmap( 0, 0,myBitmap_logo, 128, 64,WHITE );
  display.display();
  delay(3000);
  display.clearDisplay();
  //display.clearDisplay();
  display.setCursor(15, 0);
  display.println("PULSESYNC");
  //display.setCursor(35, 35);
  display.drawBitmap( 40, 20,myBitmap_logo1, 30, 26,WHITE);
  display.setCursor(45, 50);
  display.println("ISTE");
  display.display();
  
  delay(5000);
  Serial.print("Initializing pulse oximeter..");
 
  if (!pox.begin())
  {
  Serial.println("FAILED");
  display.clearDisplay();
  display.setTextSize(1);
  display.setTextColor(1);
  display.setCursor(0, 0);
  display.println("FAILED");
  display.display();
  for(;;);
  } 
  else 
  {
  display.clearDisplay();
  display.setTextSize(1);
  display.setTextColor(1);
  display.setCursor(0, 0);
  display.println("SUCCESS");
  display.display();
  Serial.println("SUCCESS");
  pox.setOnBeatDetectedCallback(onBeatDetected);
  }
  //timer.setInterval(1L, sendSensor);
  pox.setIRLedCurrent(MAX30100_LED_CURR_7_6MA);
  temp = dht.readTemperature();
  hum = dht.readHumidity();
  Blynk.virtualWrite(V3, temp);
  Blynk.virtualWrite(V4, hum);
  //timer.setInterval(1L, sendSensor);
  
}
////
void loop() 
{
  Blynk.run();
  timer.run();
  pox.update();
  float bpm = pox.getHeartRate();
  float SpO2 = pox.getSpO2();
  //h = analogRead(A0); 
  if (millis() - tsLastReport > REPORTING_PERIOD_MS) // 
  {
  Serial.print("Heart BPM:");
  Serial.print(bpm);
  Serial.print("-----");
  Serial.print("Oxygen Percent:");
  Serial.print(SpO2);
  ////
  display.clearDisplay();
  display.setTextSize(2);
  display.setTextColor(1);
  display.setCursor(45,0);
  display.println(bpm,1);
  display.setCursor(100,0);

  display.setTextSize(2);
  display.setTextColor(1);
  display.setCursor(0, 0);
  display.println("HR");
  display.setTextSize(1);
  display.setCursor(100, 0);
  display.println("bpm");
 
  display.setTextSize(2);
  display.setTextColor(1);
  display.setCursor(0, 45);
  display.println("Spo2");
  display.setTextSize(1);
  display.setCursor(110, 45);
  display.println("%");
 
  display.setTextSize(2);
  display.setTextColor(1);
  display.setCursor(60,45);
  display.println(SpO2,1);
  display.display();
  tsLastReport = millis();
  //// 
  Blynk.virtualWrite(V1, bpm);
  Blynk.virtualWrite(V2, SpO2);
  
  //Blynk.virtualWrite(V5, h);
  
 }
}

////
/*void sendSensor()
{
  int h = analogRead(A0); 
  Blynk.virtualWrite(V5, h);
  //Blynk.virtualWrite(V6, A0);
}*/
